## firmware/sdkconfig.defaults
```kconfig
# Committed ESP-IDF config seed. The generated `sdkconfig` is .gitignore'd;
# this file is the reproducible source. Console on UART0 @ 115200 is the
# default for the classic ESP32, stated here explicitly for clarity.
CONFIG_ESP_CONSOLE_UART_DEFAULT=y
CONFIG_ESP_MAIN_TASK_STACK_SIZE=4096

# --- BLE (F-03): NimBLE peripheral, single bonded central, NVS-persisted bonds ---
# Turn on the Bluetooth controller in BLE-only mode (classic ESP32 BTDM
# controller) and select the NimBLE host (smaller than Bluedroid).
CONFIG_BT_ENABLED=y
CONFIG_BTDM_CTRL_MODE_BLE_ONLY=y
CONFIG_BTDM_CTRL_MODE_BR_EDR_ONLY=n
CONFIG_BTDM_CTRL_MODE_BTDM=n
CONFIG_BT_BLUEDROID_ENABLED=n
CONFIG_BT_NIMBLE_ENABLED=y
# Single central only (contract §1.1, PRD non-goal "no multi-client physical play").
CONFIG_BT_NIMBLE_MAX_CONNECTIONS=1
# Peripheral-only: we never scan or initiate, so drop the central/observer roles.
CONFIG_BT_NIMBLE_ROLE_CENTRAL=n
CONFIG_BT_NIMBLE_ROLE_OBSERVER=n
# Persist bonding keys in NVS so a bonded central reconnects without re-pairing
# (contract §1.1). Pairs with nvs_flash_init() at boot + ble_store_config_init().
CONFIG_BT_NIMBLE_NVS_PERSIST=y
```
